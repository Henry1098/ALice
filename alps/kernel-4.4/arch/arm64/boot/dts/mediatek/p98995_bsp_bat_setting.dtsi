/*
 * Copyright (C) 2015 MediaTek Inc.
 *
 * This program is free software; you can redistribute it and/or modify
 * it under the terms of the GNU General Public License version 2 as
 * published by the Free Software Foundation.
 *
 * This program is distributed in the hope that it will be useful,
 * but WITHOUT ANY WARRANTY; without even the implied warranty of
 * MERCHANTABILITY or FITNESS FOR A PARTICULAR PURPOSE.
 * See http://www.gnu.org/licenses/gpl-2.0.html for more details.
 */
/*************************
 * Customized Battery Setting dtsi file
*************************/
&bat_comm {
	/* cust_charging.h */
	/* stop charging while in talking mode */
	stop_charging_in_takling = <1>;
	talking_recharge_voltage = <3800>;
	talking_sync_time = <60>;

	/* Battery Temperature Protection */
	mtk_temperature_recharge_support = <1>;
	max_charge_temperature = <50>;
	max_charge_temperature_minus_x_degree = <47>;
	min_charge_temperature = <0>;
	min_charge_temperature_plus_x_degree = <0 >;
	err_charge_temperature = <0xff>;

	/* Linear Charging Threshold */
	v_pre2cc_thres = <3400>;	/* unit: mV */
	v_cc2topoff_thres = <4350>;
	recharging_voltage = <4250>;
	charging_full_current = <150>;	/* unit: mA */

	/* Charging Current Setting */
	config_usb_if = <0>;
	usb_charger_current_suspend = <0>;	/* Unit: 0.01 mA */
	usb_charger_current_unconfigured = <7000>;	/* Unit: 0.01 mA */
	usb_charger_current_configured = <50000>;	/* Unit: 0.01 mA */
	usb_charger_current = <50000>;	/* Unit: 0.01 mA */
	ac_charger_current = <90000>;	/* Unit: 0.01 mA *//*Bug-342988,sunxuebin.wt,MODIFY,20180301,for charging current set to 900mA*/
	non_std_ac_charger_current = <50000>;	/* Unit: 0.01 mA */
	charging_host_charger_current = <65000>;	/* Unit: 0.01 mA */
	apple_0_5a_charger_current = <50000>;	/* Unit: 0.01 mA */
	apple_1_0a_charger_current = <65000>;	/* Unit: 0.01 mA */
	apple_2_1a_charger_current = <80000>;	/* Unit: 0.01 mA */

	/* charger error check */
	bat_low_temp_protect_enable = <0>;
	v_charger_enable = <0>;	/* 1:on , 0:off */
	v_charger_max = <6500>;	/* unit: mV */
	v_charger_min = <4400>;

	/*  Tracking TIME */
	onehundred_percent_tracking_time = <10>;	/* Unit: second */
	npercent_tracking_time = <20>;	/* Unit: second */
	sync_to_real_tracking_time = <60>;	/* Unit: second */
	v_0percent_tracking = <3400>;	/* Unit: mV */

	/* High battery support */
	high_battery_voltage_support = <1 >;
};

&bat_meter {
	/* cust_battery_meter.h */
	/* ADC resistor  */
	r_bat_sense = <4>;
	r_i_sense = <4>;
	r_charger_1 = <330>;
	r_charger_2 = <39>;
	temperature_t0 = <110>;
	temperature_t1 = <0>;
	temperature_t2 = <25>;
	temperature_t3 = <50>;
	temperature_t = <255>;	/* this should be fixed, never change the value */
	fg_meter_resistance = <0>;

//+Bug-345702,sunxuebin.wt,MODIFY,20180316,for ATL battery ZCV table update.
	/* Qmax for 0mA */
	q_max_pos_50 = <2785 >;
	q_max_pos_25 = <2787 >;
	q_max_pos_0 = <2740 >;
	q_max_neg_10 = <2693 >;
	/* Qmax for 400mA, said high current */
	q_max_pos_50_h_current = <2761 >;
	q_max_pos_25_h_current = <2751 >;
	q_max_pos_0_h_current = <2415 >;
	q_max_neg_10_h_current = <1376 >;
	/* Discharge percentage, 1: D5, 0: D2 */
	oam_d5 = <0 >;

	change_tracking_point = <1 >;
	/* SW OCV tracking setting */
	cust_tracking_point = <0>;
//-Bug-345702,sunxuebin.wt,MODIFY,20180316,for ATL battery ZCV table update.
	cust_r_sense = <200>;
	cust_hw_cc = <0>;
	aging_tuning_value = <100>;
	cust_r_fg_offset = <0>;
	ocv_board_compesate = <0>;
	r_fg_board_base = <1000>;
	r_fg_board_slope = <1000>;
	car_tune_value = <89>;

	/* HW Fuel gague  */
	current_detect_r_fg = <10>;	/* Unit: mA */
	minerroroffset = <1000>;
	fg_vbat_average_size = <18>;
	r_fg_value = <10>;	/* Unit: mOhm */

	cust_poweron_delta_capacity_tolrance = <80>;
	cust_poweron_low_capacity_tolrance = <2>;
	cust_poweron_max_vbat_tolrance = <70>;
	cust_poweron_delta_vbat_tolrance = <60>;
	cust_poweron_delta_hw_sw_ocv_capacity_tolrance = <10>;

	/* Fixed battery temperature */
	fixed_tbat_25 = <0>;
	/* Dynamic change wake up period of battery thread when suspend */
	vbat_normal_wakeup = <3600>;	/* Unit: mV */
	vbat_low_power_wakeup = <3500>;	/* Unit: mV */
	normal_wakeup_period = <5400>;	/* Unit: second */
	low_power_wakeup_period = <300>;	/* Unit: second */
	close_poweroff_wakeup_period = <30>;	/* Unit: second */

	rbat_pull_up_r = <16900>;
	rbat_pull_up_d = <30000>;
	rbat_pull_up_volt = <1800>;

//+Bug-345702,sunxuebin.wt,MODIFY,20180316,for ATL battery ZCV table and temp table update.
	batt_temperature_table_num = <17 >;
	batt_temperature_table = <
			    (-20) 68237
			    (-15) 53650
			    (-10) 42506
			    (-5) 33892
			    0 27219
			    5 22021
			    10 17926
			    15 14674
			    20 12081
			    25 10000 30 8315 35 6948 40 5834 45 4917 50 4161 55 3535 60 3014 >;

//+Bug-343194,sunxuebin.wt,MODIFY,20180305, merge from wt.guojunbo add second battery data
	battery_profile_t0_num = <58 >;
	battery_profile_t0 = <
             0	4397
	     2	4364
	     4	4338
	     6	4321
	     7	4287
	     9	4263
	     11 4241
	     13	4220
	     15	4199
	     17	4179
	     19	4159
	     20	4138
	     22	4118
	     24	4102
	     26 4085
	     28	4064
	     30	4036
	     31	4005
	     33	3982
	     35	3963
	     37	3947
	     39	3936
	     41 3924
	     43	3910
	     44	3898
	     46	3884
	     48 3873
	     50	3860
	     52	3850
	     54	3841
	     56	3831
	     57	3822
	     59	3814
	     61	3808
	     63	3801
	     65	3797
	     67	3793
	     69	3790
	     70	3787
	     72	3783
	     74 3781
	     76	3777
	     78	3774
	     80	3767
	     81 3762
	     83	3757
	     85	3751
	     87	3744
	     89	3733
	     91	3723
	     93	3712
	     94	3704
	     95	3699
	     96	3693
	     97	3565
	     98 3495
	     99	3440
	     100 3400
	>;

	battery_profile_t1_num = <58 >;
	battery_profile_t1 = <
	    0	4387
	    2	4363
	    4	4342
	    5	4318
	    7	4296
	    9	4276
	    11	4255
	    13	4232
	    15	4213
	    16	4193
	    18	4173
	    20	4152
	    22	4133
	    24	4113
	    25	4096
	    27	4081
	    29	4064
	    31	4041
	    33	4013
	    35	3989
	    36	3972
	    38	3957
	    40	3940
	    42	3925
	    44	3909
	    45	3893
	    47	3879
	    49	3868
	    51	3855
	    53	3845
	    55	3837
	    56	3828
	    58	3821
	    60	3814
	    62	3807
	    64	3801
	    65	3795
	    67	3790
	    69	3787
	    71	3783
	    73	3781
	    75	3779
	    76	3774
	    78	3770
	    80	3765
	    82	3759
	    84	3751
	    85	3741
	    87	3730
	    89	3719
	    91	3705
	    93	3699
	    95	3694
	    96	3688
	    97	3586
	    98	3499
	    99	3456
	    100	3400
	>;

	battery_profile_t2_num = <58 >;
	battery_profile_t2 = <
	    0	4379
	    2	4355
	    4	4334
	    5	4312
	    7	4291
	    9	4270
	    11	4248
	    13	4227
	    14	4207
	    16	4186
	    18	4166
	    20	4146
	    22	4126
	    23	4107
	    25	4088
	    27	4072
	    29	4055
	    30	4034
	    32	4015
	    34	3997
	    36	3982
	    38	3968
	    39	3955
	    41	3937
	    43	3915
	    45	3896
	    47	3879
	    48	3867
	    50	3856
	    52	3847
	    54	3837
	    56	3829
	    57	3822
	    59	3815
	    61	3808
	    63	3802
	    65	3797
	    66	3791
	    68	3787
	    70	3782
	    72	3777
	    74	3771
	    75	3765
	    77	3757
	    79	3751
	    81	3745
	    82	3738
	    84	3728
	    86	3718
	    88	3707
	    90	3695
	    91	3692
	    93	3690
	    95	3684
	    97	3645
	    98	3569
	    99	3488
	    100	3400
	>;

	battery_profile_t3_num = <58 >;
	battery_profile_t3 = <
	    0	4381
	    2	4354
	    4	4332
	    5	4311
	    7	4289
	    9	4267
	    11	4247
	    13	4226
	    14	4205
	    16	4184
	    18	4164
	    20	4144
	    21	4125
	    23	4106
	    25	4086
	    27	4067
	    29	4051
	    30	4033
	    32	4017
	    34	4000
	    36	3986
	    38	3971
	    39	3957
	    41	3942
	    43	3926
	    45	3903
	    47	3883
	    48	3870
	    50	3859
	    52	3849
	    54	3841
	    56	3833
	    57	3824
	    59	3817
	    61	3811
	    63	3805
	    64	3797
	    66	3792
	    68	3787
	    70	3782
	    72	3775
	    73	3760
	    75	3752
	    77	3745
	    79	3736
	    81	3730
	    82	3725
	    84	3717
	    86	3704
	    88	3694
	    90	3682
	    91	3679
	    93	3678
	    95	3672
	    97	3553
	    98	3477
	    100	3400
	    100	3400
	>;

	r_profile_t0_num = <58 >;
	r_profile_t0 = <
	    927	4397
	    927	4364
	    935	4338
	    930	4312
	    920	4287
	    907	4263
	    895	4241
	    890	4220
	    883	4199
	    872	4179
	    863	4159
	    852	4138
	    840	4118
	    837	4102
	    837	4085
	    827	4064
	    812	4036
	    788	4005
	    782	3982
	    777	3963
	    770	3947
	    775	3936
	    823	3924
	    757	3910
	    760	3898
	    752	3884
	    753	3873
	    752	3860
	    760	3850
	    763	3841
	    763	3831
	    767	3822
	    772	3814
	    780	3808
	    782	3801
	    800	3797
	    812	3793
	    825	3790
	    843	3787
	    862	3783
	    880	3781
	    903	3777
	    927	3774
	    947	3767
	    977	3762
	    1003	3757
	    1035	3751
	    1072	3744
	    1102	3733
	    1137	3723
	    1173	3712
	    1215	3704
	    1278	3699
	    1348	3693
	    1443	3676
	    1865	3540
	    2865	3400
	    2865	3400
	>;

	r_profile_t1_num = <58 >;
	r_profile_t1 = <
	    413	4387
	    413	4363
	    420	4342
	    412	4318
	    408	4296
	    408	4276
	    403	4255
	    393	4232
	    398	4213
	    395	4193
	    393	4173
	    392	4152
	    388	4133
	    387	4113
	    385	4096
	    395	4081
	    402	4064
	    398	4041
	    385	4013
	    378	3989
	    378	3972
	    372	3957
	    362	3940
	    358	3925
	    352	3909
	    348	3893
	    345	3879
	    350	3868
	    347	3855
	    348	3845
	    352	3837
	    352	3828
	    353	3821
	    362	3814
	    362	3807
	    370	3801
	    377	3795
	    380	3790
	    388	3787
	    390	3783
	    402	3781
	    410	3779
	    422	3774
	    438	3770
	    453	3765
	    470	3759
	    485	3751
	    505	3741
	    525	3730
	    558	3719
	    593	3705
	    647	3699
	    717	3694
	    817	3688
	    948	3669
	    1062	3590
	    1187	3480
	    1347	3400
	>;

	r_profile_t2_num = <58 >;
	r_profile_t2 = <
	    138	4379
	    138	4355
	    140	4334
	    138	4312
	    140	4291
	    140	4270
	    140	4248
	    142	4227
	    142	4207
	    142	4186
	    147	4166
	    147	4146
	    148	4126
	    152	4107
	    152	4088
	    155	4072
	    160	4055
	    163	4034
	    167	4015
	    165	3997
	    167	3982
	    168	3968
	    167	3955
	    162	3937
	    148	3915
	    140	3896
	    133	3879
	    135	3867
	    135	3856
	    137	3847
	    135	3837
	    138	3829
	    140	3822
	    142	3815
	    143	3808
	    145	3802
	    148	3797
	    148	3791
	    152	3787
	    150	3782
	    150	3777
	    148	3771
	    147	3765
	    143	3757
	    147	3751
	    148	3745
	    150	3738
	    150	3728
	    153	3718
	    157	3707
	    155	3695
	    160	3692
	    173	3690
	    192	3684
	    190	3639
	    207	3541
	    217	3480
	    237	3400
	>;

	r_profile_t3_num = <58 >;
	r_profile_t3 = <
	    95	4381
	    95	4354
	    95	4332
	    93	4311
	    95	4289
	    95	4267
	    95	4247
	    97	4226
	    97	4205
	    97	4184
	    97	4164
	    98	4144
	    100	4125
	    102	4106
	    102	4086
	    103	4067
	    105	4051
	    107	4033
	    108	4017
	    108	4000
	    115	3986
	    113	3971
	    120	3957
	    120	3942
	    120	3926
	    107	3903
	    98	3883
	    95	3870
	    97	3859
	    95	3849
	    98	3841
	    98	3833
	    98	3824
	    102	3817
	    103	3811
	    107	3805
	    105	3797
	    107	3792
	    107	3787
	    108	3782
	    108	3775
	    95	3760
	    98	3752
	    98	3745
	    97	3736
	    97	3730
	    102	3725
	    102	3717
	    98	3704
	    102	3694
	    93	3682
	    98	3679
	    107	3678
	    117	3672
	    112	3627
	    117	3534
	    117	3480
	    128	3400
	>;
//-Bug-343194,sunxuebin.wt,MODIFY,20180305, merge from wt.guojunbo add second battery data
/*Bug-343194,sunxuebin.wt,ADD,20180305, merge from wt.guojunbo add second battery data start*/
       /* Qmax for 0mA */
	q_max_pos_50_1 = <3505>;
	q_max_pos_25_1 = <3523>;
	q_max_pos_0_1 = <3516>;
	q_max_neg_10_1 = <3525>;
	/* Qmax for 400mA, said high current */
	q_max_pos_50_h_current_1 = <3489>;
	q_max_pos_25_h_current_1 = <3500>;
	q_max_pos_0_h_current_1 = <3095>;
	q_max_neg_10_h_current_1 = <1600>;
	/* Discharge percentage, 1: D5, 0: D2 */
        batt_temperature_table_num_1 = <17 >;
	batt_temperature_table_1 = <
	    (-20) 67790
	    (-15) 53460
	    (-10) 42450
	    (-5) 33930
	    0 27280
	    5 22070
	    10 17960
	    15 14700
	    20 12090
	    25 10000
	    30 8312
	    35 6942
	    40 5826
	    45 4911
	    50 4158
	    55 3536
	    60 3019
	>;
//-Bug-345702,sunxuebin.wt,MODIFY,20180316,for ATL battery ZCV table and temp table update.
	battery_profile_t0_num_1 = <72 >;
	battery_profile_t0_1 = <
	    0 4392
	    1 4350
	    3 4321
	    4 4296
	    6 4274
	    7 4254
	    9 4236
	    10 4219
	    11 4204
	    13 4186
	    14	4170
	    16	4154
	    17	4139
	    18	4123
	    20	4110
	    21	4098
	    23	4083
	    24	4067
	    26	4048
	    27	4023
	    28	4001
	    30	3983
	    31	3966
	    33	3953
	    34	3941
	    35	3931
	    37	3921
	    38	3911
	    40	3901
	    41	3892
	    43	3882
	    44	3873
	    45	3864
	    47	3855
	    48	3848
	    50	3841
	    51	3832
	    52	3826
	    54	3819
	    55	3814
	    57	3810
	    58	3805
	    60	3802
	    61	3798
	    62	3795
	    64	3792
	    65	3789
	    67	3786
	    68	3783
	    70	3780
	    71	3777
	    72	3772
	    74	3767
	    75	3763
	    77	3758
	    78	3753
	    79	3748
	    81	3741
	    82	3736
	    84	3728
	    85	3722
	    87	3713
	    88	3707
	    89	3702
	    91	3692
	    92	3683
	    94	3659
	    95	3630
	    96	3589
	    98	3500
	    99	3433
	    100	3400
	>;

	battery_profile_t1_num_1 = <72 >;
	battery_profile_t1_1 = <
	    0   4391
	    1   4365
	    3	4343
	    4	4323
	    6	4303
	    7	4285
	    9	4267
	    10	4250
	    11	4234
	    13	4218
	    14	4202
	    16	4187
	    17	4171
	    18	4156
	    20	4140
	    21	4125
	    23	4110
	    24	4097
	    26	4087
	    27	4075
	    28	4059
	    30	4038
	    31	4013
	    33	3994
	    34	3977
	    36	3964
	    37	3953
	    38	3941
	    40	3930
	    41	3919
	    43	3907
	    44	3895
	    46	3884
	    47	3874
	    48	3865
	    50	3855
	    51	3847
	    53	3840
	    54	3834
	    55	3827
	    57	3821
	    58	3814
	    60	3810
	    61	3805
	    63	3800
	    64	3796
	    65	3793
	    67	3790
	    68	3788
	    70	3785
	    71	3783
	    73	3781
	    74	3779
	    75	3772
	    77	3766
	    78	3762
	    80	3755
	    81	3749
	    82	3743
	    84	3733
	    85	3726
	    87	3714
	    88	3706
	    90	3697
	    91	3691
	    92	3685
	    94	3667
	    95	3644
	    97	3571
	    98	3490
	    100	3400
	    100	3400

	>;

	battery_profile_t2_num_1 = <72 >;
	battery_profile_t2_1 = <
	    0   4390
	    1   4370
	    3   4353
	    4	4336
	    6	4317
	    7	4299
	    9	4283
	    10	4266
	    11	4250
	    13	4233
	    14	4218
	    16	4201
	    17	4185
	    18	4170
	    20	4154
	    21	4139
	    23	4123
	    24	4108
	    26	4092
	    27	4079
	    28	4069
	    30	4059
	    31	4040
	    33	4014
	    34	3995
	    35	3981
	    37	3971
	    38	3964
	    40	3956
	    41	3942
	    43	3928
	    44	3913
	    45	3899
	    47	3887
	    48	3876
	    50	3865
	    51	3857
	    53	3849
	    54	3842
	    55	3836
	    57	3829
	    58	3823
	    60	3818
	    61	3812
	    62	3806
	    64	3801
	    65	3797
	    67	3793
	    68	3788
	    70	3785
	    71	3780
	    72	3775
	    74	3770
	    75	3766
	    77	3760
	    78	3754
	    79	3749
	    81	3744
	    82	3738
	    84	3731
	    85	3722
	    87	3714
	    88	3704
	    89	3693
	    91	3688
	    92	3684
	    94	3670
	    95	3651
	    97	3586
	    98	3516
	    99	3444
	    100	3400
	>;

	battery_profile_t3_num_1 = <72 >;
	battery_profile_t3_1 = <
	     0	4393
	     1	4365
	     3	4346
	     4	4330
	     6	4312
	     7	4296
	     9	4279
	     10	4263
	     11	4247
	     13	4230
	     14 4214
	     16 4198
	     17 4182
	     19 4166
	     20	4151
	     21 4135
	     23	4120
	     24	4105
	     26	4090
	     27 4076
	     29 4061
	     30	4048
	     31	4035
	     33	4019
	     34 4006
	     36 3996
	     37 3983
	     39 3972
	     40	3961
	     41	3949
	     43	3937
	     44	3923
	     46	3904
	     47	3887
	     49	3876
	     50	3867
	     51	3857
	     53	3850
	     54	3842
	     56 3836
	     57	3829
	     58	3823
	     60	3816
	     61	3811
	     63	3806
	     64	3801
	     66	3796
	     67	3792
	     68	3788
	     70	3783
	     71 3779
	     73	3770
	     74	3759
	     76 3752
	     77 3746
	     78	3739
	     80	3733
	     81	3728
	     83 3723
	     84	3715
	     86 3706
	     87 3698
	     88	3686
	     90 3678
	     91 3677
	     93 3665
	     94 3654
	     96 3614
	     97 3561
	     98	3498
	     100 3400
	     100 3400
	>;

	r_profile_t0_num_1 = <72 >;
	r_profile_t0_1 = <
	    1680  4392
	    1680  4350
	    1662  4321
	    1626  4296
	    1586  4274
	    1557  4254
	    1524  4236
	    1501  4219
	    1479  4204
	    1452  4186
	    1428  4170
	    1400  4154
	    1375  4139
	    1352  4123
	    1333  4110
	    1325  4098
	    1313  4083
	    1298  4067
	    1271  4048
	    1248  4023
	    1223  4001
	    1208  3983
	    1198  3966
	    1195  3953
	    1187  3941
	    1186  3931
	    1180  3921
	    1171  3911
	    1169  3901
	    1169  3892
	    1167  3882
	    1166  3873
	    1166  3864
	    1166  3855
	    1167  3848
	    1167  3841
	    1166  3832
	    1164  3826
	    1164  3819
	    1170  3814
	    1178  3810
	    1187  3805
	    1204  3802
	    1218  3798
	    1236  3795
	    1248  3792
	    1265  3789
	    1280  3786
	    1293  3783
	    1307  3780
	    1321  3777
	    1335  3772
	    1347  3767
	    1364  3763
	    1384  3758
	    1400  3753
	    1418  3748
	    1435  3741
	    1457  3736
	    1479  3728
	    1501  3722
	    1524  3713
	    1555  3707
	    1587  3702
	    1628  3692
	    1671  3683
	    1725  3659
	    1784  3630
	    1839  3589
	    1901  3500
	    1650  3433
	    1329  3400
	>;

	r_profile_t1_num_1 = <72 >;
	r_profile_t1_1 = <
	    837	4391
	    837	4365
	    850	4343
	    849 4323
	    843	4303
	    838	4285
	    834 4267
	    828 4250
	    820 4234
	    816 4218
	    811 4202
	    805	4187
	    800	4171
	    795 4156
	    785 4140
	    783 4125
	    777	4110
	    775	4097
	    777	4087
	    774 4075
	    761 4059
	    738 4038
	    719	4013
	    705 3994
	    698 3977
	    694 3964
	    695	3953
	    681 3941
	    678 3930
	    664	3919
	    657	3907
	    646	3895
	    639 3884
	    636	3874
	    631 3865
	    625	3855
	    622 3847
	    614	3840
	    616	3834
	    615 3827
	    611	3821
	    605	3814
	    606 3810
	    609 3805
	    605 3800
	    604	3796
	    607	3793
	    595	3790
	    586 3788
	    595	3785
	    615	3783
	    620 3781
	    608 3779
	    586 3772
	    600 3766
	    623 3762
	    646	3755
	    668	3749
	    691 3743
	    713 3733
	    730 3726
	    759 3714
	    783 3706
	    817 3697
	    850 3691
	    896 3685
	    950	3667
	    1020 3644
	    1098 3571
	    1174 3490
	    1308 3400
	    1174 3400
	>;

	r_profile_t2_num_1 = <72 >;
	r_profile_t2_1 = <
	    171 4390
	    171	4370
	    173	4353
	    172	4336
	    172 4317
	    164 4299
	    168 4283
	    169 4266
	    172 4250
	    172 4233
	    178 4218
	    180 4201
	    181 4185
	    183 4170
	    186 4154
	    188 4139
	    191 4123
	    192 4108
	    194 4092
	    198 4079
	    208 4069
	    219 4059
	    214 4040
	    202	4014
	    200 3995
	    203	3981
	    205	3971
	    211 3964
	    212 3956
	    205 3942
	    195 3928
	    186 3913
	    178	3899
	    174 3887
	    169 3876
	    168 3865
	    166 3857
	    166 3849
	    167 3842
	    161 3836
	    160 3829
	    163 3823
	    166 3818
	    166 3812
	    169 3806
	    166 3801
	    167 3797
	    169 3793
	    171 3788
	    172 3785
	    171 3780
	    171 3775
	    169 3770
	    168 3766
	    166 3760
	    163 3754
	    166 3749
	    165 3744
	    168 3738
	    166 3731
	    166 3722
	    169	3714
	    167 3704
	    166 3693
	    169 3688
	    175 3684
	    183 3670
	    198 3651
	    191 3586
	    194 3516
	    209 3444
	    267	3400
	>;

	r_profile_t3_num_1 = <72 >;
	r_profile_t3_1 = <
	    113	4393
	    113 4365
	    111	4346
	    112 4330
	    111	4312
	    110 4296
	    111 4279
	    112 4263
	    112 4247
	    113 4230
	    111 4214
	    115 4198
	    113 4182
	    113 4166
	    115 4151
	    115 4135
	    115 4120
	    115 4105
	    116 4090
	    118 4076
	    118 4061
	    118 4048
	    122 4035
	    119 4019
	    123 4006
	    124 3996
	    126 3983
	    129	3972
	    132 3961
	    135 3949
	    137 3937
	    138 3923
	    126 3904
	    115 3887
	    113 3876
	    113 3867
	    112 3857
	    113 3850
	    113 3842
	    113 3836
	    113 3829
	    113 3823
	    115 3816
	    115 3811
	    116 3806
	    118 3801
	    119 3796
	    123 3792
	    124 3788
	    124 3783
	    127 3779
	    120 3770
	    113 3759
	    116 3752
	    116 3746
	    116 3739
	    116 3733
	    116 3728
	    118 3723
	    116 3715
	    116 3706
	    118 3698
	    116 3686
	    113 3678
	    115 3673
	    118 3665
	    124 3654
	    130 3614
	    123	3561
	    129 3498
            141	3400
	    242 3400
	>;
/*Bug-343194,sunxuebin.wt,ADD,20180305, merge from wt.guojunbo add second battery data end*/
};
