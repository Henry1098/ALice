/*
 * Copyright (C) 2015 MediaTek Inc.
 *
 * This program is free software; you can redistribute it and/or modify
 * it under the terms of the GNU General Public License version 2 as
 * published by the Free Software Foundation.
 *
 * This program is distributed in the hope that it will be useful,
 * but WITHOUT ANY WARRANTY; without even the implied warranty of
 * MERCHANTABILITY or FITNESS FOR A PARTICULAR PURPOSE.
 * See http://www.gnu.org/licenses/gpl-2.0.html for more details.
 */
/*************************
 * Customized Battery Setting dtsi file
*************************/
&bat_comm {
	/* cust_charging.h */
	/* stop charging while in talking mode */
	stop_charging_in_takling = <1>;
	talking_recharge_voltage = <3800>;
	talking_sync_time = <60>;

	/* Battery Temperature Protection */
	mtk_temperature_recharge_support = <1>;
	max_charge_temperature = <50>;
	max_charge_temperature_minus_x_degree = <47>;
	min_charge_temperature = <0>;
	min_charge_temperature_plus_x_degree = <0 >;
	err_charge_temperature = <0xff>;

	/* Linear Charging Threshold */
	v_pre2cc_thres = <3400>;	/* unit: mV */
	v_cc2topoff_thres = <4250>;
	recharging_voltage = <4150>;
	charging_full_current = <260>;	/* unit: mA */ 

	/* Charging Current Setting */
	config_usb_if = <0>;
	usb_charger_current_suspend = <0>;	/* Unit: 0.01 mA */
	usb_charger_current_unconfigured = <7000>;	/* Unit: 0.01 mA */
	usb_charger_current_configured = <50000>;	/* Unit: 0.01 mA */
	usb_charger_current = <50000>;	/* Unit: 0.01 mA */
	ac_charger_current = <90000>;	/* Unit: 0.01 mA *//*Bug-342988,sunxuebin.wt,MODIFY,20180301,for charging current set to 900mA*/
	non_std_ac_charger_current = <50000>;	/* Unit: 0.01 mA */
	charging_host_charger_current = <65000>;	/* Unit: 0.01 mA */
	apple_0_5a_charger_current = <50000>;	/* Unit: 0.01 mA */
	apple_1_0a_charger_current = <65000>;	/* Unit: 0.01 mA */
	apple_2_1a_charger_current = <80000>;	/* Unit: 0.01 mA */

	/* charger error check */
	bat_low_temp_protect_enable = <1>;	//ExtB-AQUA-812,sunxuebin.wt,MODIFY,20180409,for low temp charging control.
	v_charger_enable = <0>;	/* 1:on , 0:off */
	v_charger_max = <6500>;	/* unit: mV */
	v_charger_min = <4400>;

	/*  Tracking TIME */
	onehundred_percent_tracking_time = <10>;	/* Unit: second */
	npercent_tracking_time = <20>;	/* Unit: second */
	sync_to_real_tracking_time = <60>;	/* Unit: second */
	v_0percent_tracking = <3400>;	/* Unit: mV */

	/* High battery support */
	high_battery_voltage_support = <1 >;
};

&bat_meter {
	/* cust_battery_meter.h */
	/* ADC resistor  */
	r_bat_sense = <4>;
	r_i_sense = <4>;
	r_charger_1 = <330>;
	r_charger_2 = <39>;
	temperature_t0 = <110>;
	temperature_t1 = <0>;
	temperature_t2 = <25>;
	temperature_t3 = <50>;
	temperature_t = <255>;	/* this should be fixed, never change the value */
	fg_meter_resistance = <0>;

//+Bug-345702,sunxuebin.wt,MODIFY,20180316,for ATL battery ZCV table update.
	/* Qmax for 0mA */
	q_max_pos_50 = <2785 >;
	q_max_pos_25 = <2787 >;
	q_max_pos_0 = <2740 >;
	q_max_neg_10 = <2693 >;
	/* Qmax for 400mA, said high current */
	q_max_pos_50_h_current = <2761 >;
	q_max_pos_25_h_current = <2751 >;
	q_max_pos_0_h_current = <2415 >;
	q_max_neg_10_h_current = <1376 >;
	/* Discharge percentage, 1: D5, 0: D2 */
	oam_d5 = <0 >;

	change_tracking_point = <1 >;
	/* SW OCV tracking setting */
	cust_tracking_point = <0>;
//-Bug-345702,sunxuebin.wt,MODIFY,20180316,for ATL battery ZCV table update.
	cust_r_sense = <200>;
	cust_hw_cc = <0>;
	aging_tuning_value = <100>;
	cust_r_fg_offset = <0>;
	ocv_board_compesate = <0>;
	r_fg_board_base = <1000>;
	r_fg_board_slope = <1000>;
	car_tune_value = <89>;

	/* HW Fuel gague  */
	current_detect_r_fg = <10>;	/* Unit: mA */
	minerroroffset = <1000>;
	fg_vbat_average_size = <18>;
	r_fg_value = <10>;	/* Unit: mOhm */

	cust_poweron_delta_capacity_tolrance = <80>;
	cust_poweron_low_capacity_tolrance = <2>;
	cust_poweron_max_vbat_tolrance = <70>;
	cust_poweron_delta_vbat_tolrance = <60>;
	cust_poweron_delta_hw_sw_ocv_capacity_tolrance = <10>;

	/* Fixed battery temperature */
	fixed_tbat_25 = <0>;
	/* Dynamic change wake up period of battery thread when suspend */
	vbat_normal_wakeup = <3600>;	/* Unit: mV */
	vbat_low_power_wakeup = <3500>;	/* Unit: mV */
	normal_wakeup_period = <5400>;	/* Unit: second */
	low_power_wakeup_period = <300>;	/* Unit: second */
	close_poweroff_wakeup_period = <30>;	/* Unit: second */

	rbat_pull_up_r = <16900>;
	rbat_pull_up_d = <30000>;
	rbat_pull_up_volt = <1800>;

//+Bug-345702,sunxuebin.wt,MODIFY,20180316,for ATL battery ZCV table and temp table update.
	batt_temperature_table_num = <17 >;
	batt_temperature_table = <
			    (-20) 68237
			    (-15) 53650
			    (-10) 42506
			    (-5) 33892
			    0 27219
			    5 22021
			    10 17926
			    15 14674
			    20 12081
			    25 10000 30 8315 35 6948 40 5834 45 4917 50 4161 55 3535 60 3014 >;

//+Bug-343194,sunxuebin.wt,MODIFY,20180305, merge from wt.guojunbo add second battery data
	battery_profile_t0_num = <58 >;
	battery_profile_t0 = <
             0	4330
	     2	4310
	     4	4293
	     6	4276
	     7	4259
	     9	4243
	     11 4225
	     13	4207
	     15	4189
	     17	4171
	     19	4153
	     20	4135
	     22	4118
	     24	4102
	     26 4085
	     28	4064
	     30	4036
	     31	4005
	     33	3982
	     35	3963
	     37	3947
	     39	3936
	     41 3924
	     43	3910
	     44	3898
	     46	3884
	     48 3873
	     50	3860
	     52	3850
	     54	3841
	     56	3831
	     57	3822
	     59	3814
	     61	3808
	     63	3801
	     65	3797
	     67	3793
	     69	3790
	     70	3787
	     72	3783
	     74 3781
	     76	3777
	     78	3774
	     80	3767
	     81 3762
	     83	3757
	     85	3751
	     87	3744
	     89	3733
	     91	3723
	     93	3712
	     94	3704
	     95	3699
	     96	3693
	     97	3565
	     98 3495
	     99	3440
	     100 3400
	>;

	battery_profile_t1_num = <58 >;
	battery_profile_t1 = <
            0	4325
	    2	4310
	    4	4293
	    6	4276
	    7	4259
	    9	4243
	    11	4225
	    13	4207
	    15	4189
	    17	4171
	    19	4153
	    20	4135
	    22	4133
	    24	4113
	    25	4096
	    27	4081
	    29	4064
	    31	4041
	    33	4013
	    35	3989
	    36	3972
	    38	3957
	    40	3940
	    42	3925
	    44	3909
	    45	3893
	    47	3879
	    49	3868
	    51	3855
	    53	3845
	    55	3837
	    56	3828
	    58	3821
	    60	3814
	    62	3807
	    64	3801
	    65	3795
	    67	3790
	    69	3787
	    71	3783
	    73	3781
	    75	3779
	    76	3774
	    78	3770
	    80	3765
	    82	3759
	    84	3751
	    85	3741
	    87	3730
	    89	3719
	    91	3705
	    93	3699
	    95	3694
	    96	3688
	    97	3586
	    98	3499
	    99	3456
	    100	3400
	>;

	battery_profile_t2_num = <58 >;
	battery_profile_t2 = <
            0	4330
	    2	4310
	    4	4293
	    6	4276
	    7	4259
	    9	4243
	    11	4225
	    13	4207
	    14	4189
	    16	4171
	    18	4153
	    20	4135
	    22	4126
	    23	4107
	    25	4088
	    27	4072
	    29	4055
	    30	4034
	    32	4015
	    34	3997
	    36	3982
	    38	3968
	    39	3955
	    41	3937
	    43	3915
	    45	3896
	    47	3879
	    48	3867
	    50	3856
	    52	3847
	    54	3837
	    56	3829
	    57	3822
	    59	3815
	    61	3808
	    63	3802
	    65	3797
	    66	3791
	    68	3787
	    70	3782
	    72	3777
	    74	3771
	    75	3765
	    77	3757
	    79	3751
	    81	3745
	    82	3738
	    84	3728
	    86	3718
	    88	3707
	    90	3695
	    91	3692
	    93	3690
	    95	3684
	    97	3645
	    98	3569
	    99	3488
	    100	3400
	>;

	battery_profile_t3_num = <58 >;
	battery_profile_t3 = <
            0	4330
	    2	4310
	    4	4293
	    5	4276
	    7	4259
	    9	4243
	    11	4225
	    13	4207
	    14	4189
	    16	4171
	    18	4153
	    20	4135
	    21	4125
	    23	4106
	    25	4086
	    27	4067
	    29	4051
	    30	4033
	    32	4017
	    34	4000
	    36	3986
	    38	3971
	    39	3957
	    41	3942
	    43	3926
	    45	3903
	    47	3883
	    48	3870
	    50	3859
	    52	3849
	    54	3841
	    56	3833
	    57	3824
	    59	3817
	    61	3811
	    63	3805
	    64	3797
	    66	3792
	    68	3787
	    70	3782
	    72	3775
	    73	3760
	    75	3752
	    77	3745
	    79	3736
	    81	3730
	    82	3725
	    84	3717
	    86	3704
	    88	3694
	    90	3682
	    91	3679
	    93	3678
	    95	3672
	    97	3553
	    98	3477
	    100	3400
	    100	3400
	>;

	r_profile_t0_num = <58 >;
	r_profile_t0 = <
	    957	4330
	    957	4328
	    965	4335
	    960	4312
	    950	4287
	    937	4263
	    925	4241
	    920	4220
	    913	4199
	    902	4179
	    893	4159
	    882	4138
	    870	4118
	    867	4102
	    867	4085
	    857	4064
	    842	4036
	    818	4005
	    812	3982
	    807	3963
	    800	3947
	    805	3936
	    853	3924
	    787	3910
	    790	3898
	    782	3884
	    783	3873
	    782	3860
	    790	3850
	    793	3841
	    793	3831
	    797	3822
	    802	3814
	    810	3808
	    812	3801
	    830	3797
	    842	3793
	    855	3790
	    873	3787
	    892	3783
	    910	3781
	    933	3777
	    957	3774
	    977	3767
	    1007	3762
	    1033	3757
	    1065	3751
	    1102	3744
	    1132	3733
	    1167	3723
	    1203	3712
	    1245	3704
	    1308	3699
	    1378	3693
	    1473	3676
	    1895	3540
	    2895	3400
	    2895	3400
	>;

	r_profile_t1_num = <58 >;
	r_profile_t1 = <
	    443	4330
	    443	4328
	    450	4325
	    442	4318
	    438	4296
	    438	4276
	    433	4255
	    423	4232
	    428	4213
	    425	4193
	    423	4173
	    422	4152
	    418	4133
	    417	4113
	    415	4096
	    425	4081
	    432	4064
	    428	4041
	    415	4013
	    408	3989
	    408	3972
	    402	3957
	    392	3940
	    388	3925
	    382	3909
	    378	3893
	    375	3879
	    380	3868
	    377	3855
	    378	3845
	    382	3837
	    382	3828
	    383	3821
	    392	3814
	    392	3807
	    400	3801
	    407	3795
	    410	3790
	    418	3787
	    420	3783
	    432	3781
	    440	3779
	    452	3774
	    468	3770
	    483	3765
	    500	3759
	    515	3751
	    535	3741
	    555	3730
	    588	3719
	    623	3705
	    677	3699
	    747	3694
	    847	3688
	    978	3669
	    1092	3590
	    1217	3480
	    1377	3400
	>;

	r_profile_t2_num = <58 >;
	r_profile_t2 = <
	    168	4330
	    168	4325
	    170	4319
	    168	4312
	    170	4291
	    170	4270
	    170	4248
	    172	4227
	    172	4207
	    172	4186
	    177	4166
	    177	4146
	    178	4126
	    182	4107
	    182	4088
	    185	4072
	    190	4055
	    193	4034
	    197	4015
	    195	3997
	    197	3982
	    198	3968
	    197	3955
	    192	3937
	    178	3915
	    170	3896
	    163	3879
	    165	3867
	    165	3856
	    167	3847
	    165	3837
	    168	3829
	    170	3822
	    172	3815
	    173	3808
	    175	3802
	    178	3797
	    178	3791
	    182	3787
	    180	3782
	    180	3777
	    178	3771
	    177	3765
	    173	3757
	    177	3751
	    178	3745
	    180	3738
	    180	3728
	    183	3718
	    187	3707
	    185	3695
	    190	3692
	    203	3690
	    222	3684
	    220	3639
	    237	3541
	    247	3480
	    267	3400
	>;

	r_profile_t3_num = <58 >;
	r_profile_t3 = <
	    125	4330
	    125	4325
	    125	4318
	    123	4311
	    125	4289
	    125	4267
	    125	4247
	    127	4226
	    127	4205
	    127	4184
	    127	4164
	    128	4144
	    130	4125
	    132	4106
	    132	4086
	    133	4067
	    135	4051
	    137	4033
	    138	4017
	    138	4000
	    145	3986
	    143	3971
	    150	3957
	    150	3942
	    150	3926
	    137	3903
	    128	3883
	    125	3870
	    127	3859
	    125	3849
	    128	3841
	    128	3833
	    128	3824
	    132	3817
	    133	3811
	    137	3805
	    135	3797
	    137	3792
	    137	3787
	    138	3782
	    138	3775
	    125	3760
	    128	3752
	    128	3745
	    127	3736
	    127	3730
	    132	3725
	    132	3717
	    128	3704
	    132	3694
	    123	3682
	    128	3679
	    137	3678
	    147	3672
	    142	3627
	    147	3534
	    147	3480
	    158	3400
	>;
//-Bug-343194,sunxuebin.wt,MODIFY,20180305, merge from wt.guojunbo add second battery data
/*Bug-343194,sunxuebin.wt,ADD,20180305, merge from wt.guojunbo add second battery data start*/
       /* Qmax for 0mA */
	q_max_pos_50_1 = <3505>;
	q_max_pos_25_1 = <3523>;
	q_max_pos_0_1 = <3516>;
	q_max_neg_10_1 = <3525>;
	/* Qmax for 400mA, said high current */
	q_max_pos_50_h_current_1 = <3489>;
	q_max_pos_25_h_current_1 = <3500>;
	q_max_pos_0_h_current_1 = <3095>;
	q_max_neg_10_h_current_1 = <1600>;
	/* Discharge percentage, 1: D5, 0: D2 */
        batt_temperature_table_num_1 = <17 >;
	batt_temperature_table_1 = <
	    (-20) 67790
	    (-15) 53460
	    (-10) 42450
	    (-5) 33930
	    0 27280
	    5 22070
	    10 17960
	    15 14700
	    20 12090
	    25 10000
	    30 8312
	    35 6942
	    40 5826
	    45 4911
	    50 4158
	    55 3536
	    60 3019
	>;
//-Bug-345702,sunxuebin.wt,MODIFY,20180316,for ATL battery ZCV table and temp table update.
	battery_profile_t0_num_1 = <58 >;
	battery_profile_t0_1 = <
             0	4330
	     2	4310
	     4	4293
	     5	4276
	     7	4259
	     9	4243
	     11	4226
	     12	4207
	     14	4184
	     16	4163
	     18	4143
	     20	4123
	     21	4107
	     23	4087
	     25	4069
	     26	4046
	     28	4018
	     30	3991
	     32	3970
	     33	3952
	     35	3938
	     37	3926
	     39	3913
	     40	3901
	     42	3888
	     44	3877
	     46	3866
	     47	3856
	     49	3845
	     51	3836
	     53	3828
	     54	3820
	     56	3813
	     58	3807
	     60	3802
	     61	3797
	     63	3792
	     65	3789
	     67	3786
	     68	3782
	     70	3778
	     72	3775
	     74	3771
	     75	3765
	     77	3760
	     79	3755
	     81	3748
	     82	3739
	     84	3730
	     86	3721
	     88	3712
	     89	3705
	     91	3699
	     93	3689
	     95	3665
	     96	3602
	     98	3511
	     100	3400
	>;

	battery_profile_t1_num_1 = <58 >;
	battery_profile_t1_1 = <
             0	4330
	     2	4310
	     4	4293
	     5	4276
	     7	4259
	     9	4243
	     11	4226
	     12	4207
	     14	4184
	     16	4163
	     18	4143
	     20	4123
	     21	4107
	     23	4090
	     25	4076
	     27	4058
	     28	4032
	     30	4006
	     32	3985
	     34	3969
	     35	3954
	     37	3941
	     39	3925
	     41	3910
	     43	3895
	     44	3881
	     46	3869
	     48	3857
	     50	3846
	     51	3837
	     53	3828
	     55	3820
	     57	3813
	     59	3807
	     60	3802
	     62	3796
	     64	3792
	     66	3789
	     67	3786
	     69	3783
	     71	3780
	     73	3777
	     74	3773
	     76	3769
	     78	3764
	     80	3758
	     82	3750
	     83	3740
	     85	3730
	     87	3719
	     89	3706
	     90	3697
	     92	3692
	     94	3686
	     96	3669
	     98	3596
	     99	3465
	     100	3400
	>;

	battery_profile_t2_num_1 = <58 >;
	battery_profile_t2_1 = <
             0	4330
	     2	4310
	     4	4293
	     5	4276
	     7	4259
	     9	4243
	     11 4225
	     13	4207
	     14	4190
	     16	4174
	     18	4153
	     20	4143
	     21	4123
	     22	4116
	     23	4097
	     25	4079
	     27	4066
	     29	4050
	     30	4022
	     32	3999
	     34	3983
	     36	3971
	     38	3963
	     39	3950
	     41	3937
	     43	3921
	     45	3903
	     46	3883
	     48	3867
	     50	3854
	     52	3844
	     54	3835
	     55	3826
	     57	3819
	     59	3812
	     61	3806
	     63	3800
	     64	3795
	     66	3790
	     68	3785
	     70	3781
	     71	3777
	     73	3772
	     75	3766
	     77	3760
	     79	3753
	     80	3746
	     82	3740
	     84	3730
	     86	3719
	     88	3709
	     89	3694
	     91	3690
	     93	3688
	     95	3684
	     96	3655
	     98	3565
	     100	3400
	>;

	battery_profile_t3_num_1 = <58 >;
	battery_profile_t3_1 = <
	     0	4330
	     2	4310
	     4	4293
	     5	4276
	     7	4259
	     9	4243
	     11 4225
	     13	4207
	     14	4190
	     16	4174
	     18	4153
	     20	4143
	     21	4123
             22	4104
             23	4086
             25	4068
             27	4050
             29	4034
             31	4017
             32	4001
             34	3986
             36	3971
             38	3958
             40	3944
             41	3931
             43	3914
             45	3894
             47	3874
             49	3860
             50	3850
             52	3840
             54	3831
             56	3823
             58	3816
             59	3809
             61	3803
             63	3797
             65	3792
             67	3787
             68	3782
             70	3777
             72	3770
             74	3757
             76	3749
             77	3742
             79	3735
             81	3728
             83	3722
             85	3712
             86	3702
             88	3690
             90	3679
             92	3678
             94	3675
             95	3669
             97	3617
             99	3515
             100	3400
	>;

	r_profile_t0_num_1 = <58 >;
	r_profile_t0_1 = <
             1847	4330
             1847	4310
             1786	4293
             1729	4276
             1676	4259
             1624	4243
             1577	4226
             1554	4207
             1521	4184
             1490	4163
             1472	4143
             1445	4123
             1425	4107
             1425	4087
             1416	4069
             1393	4046
             1376	4018
             1352	3991
             1349	3970
             1343	3952
             1343	3938
             1344	3926
             1341	3913
             1346	3901
             1338	3888
             1337	3877
             1334	3866
             1335	3856
             1329	3845
             1332	3836
             1334	3828
             1337	3820
             1348	3813
             1354	3807
             1371	3802
             1380	3797
             1400	3792
             1420	3789
             1436	3786
             1464	3782
             1486	3778
             1513	3775
             1540	3771
             1572	3765
             1585	3760
             1606	3755
             1630	3748
             1648	3739
             1678	3730
             1693	3721
             1717	3712
             1765	3705
             1825	3699
             1929	3689
             2067	3665
             1890	3602
             1664	3511
             1416	3400
	>;

	r_profile_t1_num_1 = <58 >;
	r_profile_t1_1 = <
	     1292	4330
	     1292	4310
	     1270	4293
	     1242	4276
	     1216	4259
	     1182	4243
	     1154	4226
	     1127	4207
	     1103	4184
	     1079	4163
	     1064	4143
	     1044	4123
	     1025	4107
	     1017	4090
	     1010	4076
	     999	4058
	     982	4032
	     952	4006
	     955	3985
	     962	3969
	     965	3954
	     966	3941
	     959	3925
	     952	3910
	     951	3895
	     951	3881
	     954	3869
	     957	3857
	     962	3846
	     965	3837
	     974	3828
	     976	3820
	     983	3813
	     988	3807
	     993	3802
	     997	3796
	     1002	3792
	     1011	3789
	     1024	3786
	     1031	3783
	     1039	3780
	     1050	3777
	     1064	3773
	     1075	3769
	     1095	3764
	     1109	3758
	     1135	3750
	     1165	3740
	     1193	3730
	     1239	3719
	     1286	3706
	     1352	3697
	     1424	3692
	     1506	3686
	     1605	3669
	     1687	3596
	     1659	3465
	     1242	3400
	>;

	r_profile_t2_num_1 = <58 >;
	r_profile_t2_1 = <
	     261	4330
	     261	4310
	     252	4293
	     256	4276
	     256	4259
	     260	4243
	     250	4225
	     250	4207
	     253	4190
	     255	4174
	     255	4153
	     256	4143
	     259	4123
	     261	4116
	     267	4097
	     274	4079
	     273	4066
	     263	4050
	     267	4022
	     273	3999
	     280	3983
	     289	3971
	     290	3963
	     291	3950
	     280	3937
	     269	3921
	     252	3903
	     239	3883
	     235	3867
	     236	3854
	     238	3844
	     236	3835
	     235	3826
	     236	3819
	     238	3812
	     239	3806
	     246	3800
	     253	3795
	     255	3790
	     255	3785
	     255	3781
	     256	3777
	     256	3772
	     255	3766
	     253	3760
	     255	3753
	     259	3746
	     261	3740
	     257	3730
	     258	3719
	     255	3709
	     259	3694
	     273	3690
	     290	3688
	     301	3684
	     317	3655
	     310	3565
	     307	3400
	>;

	r_profile_t3_num_1 = <58 >;
	r_profile_t3_1 = <
             188	4330
             188	4310
             186	4293
             187	4276
             185	4259
             186	4243
             183	4225
             185	4207
             185	4190
             185	4174
             188	4153
             185	4143
             186	4123
             190	4104
             188	4086
             190	4068
             194	4050
             193	4034
             194	4017
             199	4001
             199	3986
             204	3971
             210	3958
             215	3944
             213	3931
             204	3914
             191	3894
             187	3874
             187	3860
             185	3850
             186	3840
             187	3831
             187	3823
             188	3816
             190	3809
             191	3803
             194	3797
             197	3792
             199	3787
             201	3782
             199	3777
             188	3770
             188	3757
             190	3749
             190	3742
             191	3735
             193	3728
             193	3722
             193	3712
             194	3702
             190	3690
             194	3679
             201	3678
             214	3675
             205	3669
             221	3617
             269	3515
             379	3400
	>;
/*Bug-343194,sunxuebin.wt,ADD,20180305, merge from wt.guojunbo add second battery data end*/
};
