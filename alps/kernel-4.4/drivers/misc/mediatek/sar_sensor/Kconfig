## alps/kernel-4.4/drivers/misc/mediatek/sar_sensor/Kconfig
```kconfig
config MTK_SAR_SENSOR
	tristate "SX9310_SAR_sensor"
	depends on INPUT && I2C
	default n
	help 
	  Say Y to enable the SAR detection application, if N here not to use the 
	  this SAR sensor

source "drivers/misc/mediatek/sar_sensor/sxt316/Kconfig"
source "drivers/misc/mediatek/sar_sensor/sx9310/Kconfig"
```

## alps/kernel-4.4/drivers/misc/mediatek/sar_sensor/sx9310/Kconfig
```kconfig
config MTK_SAR_SX9310
	tristate "SAR SX9310 for MediaTek package"
	default n
	help
	  It support different sar sensor.
          If this option is set,
	  it will support
          SAR SX9310.
```

## alps/kernel-4.4/drivers/misc/mediatek/sar_sensor/sxt316/Kconfig
```kconfig
config MTK_SAR_SXT316
	tristate "SAR SXT316 for MediaTek package"
	default n
	help
	  It support different sar sensor.
          If this option is set,
	  it will support
          SAR SXT316.
config SAR_SENSOR_CHN_SELET
	tristate "SAR SXT316 channel selet"
	default n
	help
```

## alps/kernel-4.4/drivers/misc/mediatek/sensors-1.0/accelerometer/KXTJ3-1058-01/Kconfig
```kconfig
config MTK_KXTJ3
	bool "for support BMA222E gsensor"
	default n
	help
		This configuration is for enable or disable KXTJ3 accelerometer sensor support.
		Say Y here if you want to support this sensor.
		Say N if you not support it.
		If no sure, say N.
```
